## main/Kconfig.projbuild
```kconfig
# ⚫ AJOUTÉ (24/10/2026) : réglages du radar Wi-Fi CSI.
# Les identifiants Wi-Fi ne sont PAS ici (sdkconfig est versionné) : voir main/wifi_credentials.example.h.
menu "Radar Wi-Fi"

    config RADAR_PING_HZ
        int "Fréquence du ping vers la passerelle (Hz)"
        range 10 200
        default 100
        help
            Mode connecté : chaque réponse au ping est une trame reçue du point d'accès,
            donc un échantillon CSI. 50 à 100 Hz donnent un bon compromis réactivité / trafic.

    config RADAR_CALIB_SECONDS
        int "Durée du calibrage (s)"
        range 3 60
        default 10
        help
            Pendant le calibrage la pièce doit être vide et immobile : le bruit mesuré sert de référence au seuil.

    config RADAR_CALIB_DELAY_SECONDS
        int "Délai avant le calibrage de démarrage (s)"
        range 0 60
        default 10
        help
            Laisse le temps de quitter la pièce après la mise sous tension.

    config RADAR_DEFAULT_SENSITIVITY
        int "Sensibilité par défaut (1..10)"
        range 1 10
        default 6

    config RADAR_PRESENCE_HOLD_SECONDS
        int "Maintien de la présence après le dernier mouvement (s)"
        range 2 300
        default 20

    # ⚫ AJOUTÉ (25/10/2026) : portée de détection affichée et vue par défaut
    config RADAR_RANGE_M
        int "Portée affichée (m)"
        range 2 20
        default 8
        help
            Rayon de la zone dessinée autour du kit (anneaux tous les quarts de portée).
            En intérieur, avec une box 2,4 GHz classique, un mouvement humain se détecte en pratique jusqu'à
            ~8-10 m en vue directe et ~5 m à travers une ou deux cloisons ; au-delà, la perturbation se noie
            dans le bruit. Augmenter cette valeur agrandit l'échelle, pas la portée physique.

    config RADAR_VIEW_3D
        bool "Vue 3D au démarrage (sinon radar 2D)"
        default y
        help
            Appui long (1,5 s) sur l'encodeur : bascule entre la vue 3D et la vue radar 2D.

    # ⚫ AJOUTÉ (25/10/2026) : portail de configuration Wi-Fi
    config RADAR_AP_SSID
        string "Nom du réseau de configuration (point d'accès du kit)"
        default "RadarWifi_Config"
        help
            Sans réseau enregistré (ou si la connexion échoue), le kit crée ce réseau ouvert et affiche un
            QR code pour le rejoindre : la page de configuration (http://192.168.4.1) s'ouvre toute seule.
            Appui de 4 s sur l'encodeur : rouvrir le portail à tout moment.

    config RADAR_STA_TIMEOUT_SECONDS
        int "Délai de connexion au réseau enregistré avant d'ouvrir le portail (s)"
        range 10 120
        default 30

    config RADAR_LED_BRIGHTNESS
        int "Luminosité max de l'anneau de LED (0..255)"
        range 0 255
        default 40
        help
            13 LED à 100 % consomment ~0,8 A : rester bas sur une alimentation USB.

endmenu
```
